/* Link layout for GAME.EXE v1.0.3: one flat image at 0x800C4000, input sections in the exact
   original order (build/link_order.ld, generated by tools/disasm.py). Input sections keep their own
   alignment: asm data chunks declare the alignment of their original address, so the gaps the
   original linker left (e.g. a 15-byte .data followed by an aligned string pool) reappear as fill. */
OUTPUT_ARCH(mips)
ENTRY(_start)
INCLUDE config/symbols_abs.ld
SECTIONS
{
    . = 0x800c4000;
    .image : {
        INCLUDE build/link_order.ld
    }
    /DISCARD/ : { *(.reginfo) *(.MIPS.abiflags) *(.pdr) *(.mdebug*) *(.comment) *(.gnu.attributes) *(.note*) }
}
