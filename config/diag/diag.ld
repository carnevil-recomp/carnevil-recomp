/* Link layout for DIAG.EXE (v1.0.3 partition, diagnostics 3.4): one flat image at 0x80100000,
   input sections in the original order (build/diag/link_order.ld, generated by
   tools/build/disasm.py), as config/game.ld for GAME.EXE. */
OUTPUT_ARCH(mips)
ENTRY(_start)
INCLUDE config/diag/symbols_abs.ld
SECTIONS
{
    . = 0x80100000;
    .image : {
        INCLUDE build/diag/link_order.ld
    }
    INCLUDE build/diag/link_bss.ld
    /DISCARD/ : { *(.reginfo) *(.MIPS.abiflags) *(.pdr) *(.mdebug*) *(.comment) *(.gnu.attributes) *(.note*) }
}
